void loop() {
  ButtSet.tick();  // Обязательная функция отработки кнопки Setting "set_But". Она должна постоянно опрашиваться


  /*Одинарное, двойное или тройное нажатие кнопки Setting "set_But" для выбора настройки*/
  //Одинарное нажатие кнопки Setting (Вкл./откл. бузера)
  if (ButtSet.hasClicks(1)) {
    BuzzToggle = !BuzzToggle;          // Инвертируем флаг бузера
    EEPROM.put(addrBuz, BuzzToggle);   // Сохраняем значение флага в EEPROM по адресу "addrBuz"
  }

  //Двойное нажатие кнопки Setting (Вкл./Откл. Панель 2 - BLUE)
  if (ButtSet.hasClicks(2)) {
    BlueToggle = !BlueToggle;           // Инвертируем флаг LED панели
    EEPROM.put(addrBlue, BlueToggle);   // Сохраняем значение флага в EEPROM по адресу "addrBlue"
  }

  // Тройное нажатие кнопки Setting (Показать напряжение МК)
  if (ButtSet.hasClicks(3)) {
    //Выключаем все светодиоды
    PORTB = B00000000;        // Выключаем все LED на порту "B"
    PORTD = B00000000;        // Выключаем все LED на порту "D"

    delay(700);     // Задержка для лучшего восприятия между режимами переключаниями выпавшей кости и остатком заряда аккумулятора
    Battery();      // Показать напряжение МК из Функции "Battery()"
  }


  /*Кидаем кости кнопкой Reset*/
  //Обработка нажатия кнопки Reset "res_But", так же проверка, если флаг "ResetPusk" поднят, то делаем автобросок
  //Автобросок необходим, потому, что при нажатии кнопки "Reset" МК только выходит из сна и ждёт нажатия кнопки, что бы обратится к функции наже.
  if ((isButtonPressed(res_But) && millis() - BtnTimer > TIME_BTN_BOUNCE) || ResetPusk == true) {    // Обращаемся к функции при нажатии кнопки Reset с защитой от антидребезга или проверке флага автоброска
    //Чтение значений флагов из EEPROM
    EEPROM.get(addrBuz, BuzzToggle);    // Читаем из адреса "addrBuz" состояние "BuzzToggle" (Вкл./Откл. бузера)
    EEPROM.get(addrBlue, BlueToggle);   // Читаем из адреса "addrBlue" состояние "BlueToggle" (Вкл./Откл. BLUE LED панели)

    //Вывод Анимации и порядок отображения значений только в таком порядке: "Animation", "BLUE_Cube", "RED_Cube".
    //Так как звук воспроизводится только в функции "RED_Cube ()".
    Animation ();   // Запускаем Анимацию
    BLUE_Cube ();   // Запускаем рандом и вывод Панели 2
    RED_Cube ();    // Запускаем рандом и вывод Панели 1

    timer = millis();      // Записываем текущее время в "timer"
    BtnTimer = millis();   // Записываем текущее время в "BtnTimer"
    ResetPusk = false;     // Опускаем флаг автоброска кубика(ков) до ухода в сон
  }
  sleep_On ();    // Идём спать!
}
